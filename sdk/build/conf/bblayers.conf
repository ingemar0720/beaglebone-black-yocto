## sdk/build/conf/bblayers.conf
```bitbake
# POKY_BBLAYERS_CONF_VERSION is increased each time build/conf/bblayers.conf
# changes incompatibly
POKY_BBLAYERS_CONF_VERSION = "2"

BBPATH = "${TOPDIR}"
BBFILES ?= ""

BBLAYERS ?= " \
    ${PWD}/../../poky-zeus/meta \
    ${PWD}/../../poky-zeus/meta-poky \
    ${PWD}/../../poky-zeus/meta-openembedded/meta-oe \
    ${PWD}/../../poky-zeus/meta-openembedded/meta-multimedia \
    ${PWD}/../../poky-zeus/meta-openembedded/meta-networking \
    ${PWD}/../../poky-zeus/meta-openembedded/meta-perl \
    ${PWD}/../../poky-zeus/meta-openembedded/meta-python \
    ${PWD}/../../poky-zeus/meta-openembedded/meta-filesystems \
    ${PWD}/../../poky-zeus/meta-virtualization \
    ${PWD}/../../poky-zeus/meta-qt5 \
    ${PWD}/../../poky-zeus/meta-raspberrypi \
    ${PWD}/../../poky-zeus/meta-security \  
    ${PWD}/../build/meta-rpi \  
  "
```

## sdk/build/meta-bbb/conf/distro/bbb.conf
```bitbake
include conf/distro/poky.conf
DISTRO = "bbb"
DISTRO_NAME = "bbb"
DISTRO_VERSION = "1.0"

# Use systemd as init manager
DISTRO_FEATURES_append = " virtualization systemd"
DISTRO_FEATURES_BACKFILL_CONSIDERED += "sysvinit"
VIRTUAL-RUNTIME_init_manager = "systemd"
VIRTUAL-RUNTIME_initscripts = "systemd-compat-units"
```

## sdk/build/meta-rpi/conf/distro/rpi.conf
```bitbake
include conf/distro/poky.conf
DISTRO = "rpi"
DISTRO_NAME = "rpi"
DISTRO_VERSION = "1.0"

# Use systemd as init manager
DISTRO_FEATURES_append = " virtualization systemd bluez5 bluetooth wifi"
DISTRO_FEATURES_BACKFILL_CONSIDERED += "sysvinit"
VIRTUAL-RUNTIME_init_manager = "systemd"
VIRTUAL-RUNTIME_initscripts = "systemd-compat-units"
```
